// SPDX-FileCopyrightText: Copyright (C) Arduino s.r.l.
// SPDX-License-Identifier: MPL-2.0

#include "Arduino_RouterBridge.h"
#include <Wire.h>
#include <U8g2lib.h>

// Set up the OLED display using U8g2
U8G2_SSD1306_128X64_NONAME_F_HW_I2C display(U8G2_R0, /* reset=*/ U8X8_PIN_NONE);

// Define our hardware pins
int potPin = A0;
int buzzerPin = 8;
int previousPart = -1;

// =======================================================
// IMAGE ARRAYS (Must be exactly 32x32 pixels = 128 bytes)
// Replace the 0x00s with your actual image2cpp hex codes!
// =======================================================

const unsigned char imagePratik[] PROGMEM = {
0xff, 0xff, 0xff, 0xff, 0xff, 0xff, 0xff, 0xff, 0xff, 0xff, 0xff, 0xff, 0xff, 0xff, 0xff, 0xff, 
0xff, 0xff, 0xff, 0xff, 0xff, 0xff, 0xff, 0xff, 0xff, 0xff, 0xff, 0xff, 0xff, 0xff, 0xff, 0xff, 
0xff, 0xff, 0xff, 0xff, 0xff, 0xff, 0xff, 0xff, 0xff, 0xff, 0xff, 0xff, 0xff, 0xff, 0xff, 0xff, 
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0xff, 0xff, 0xff, 0xff, 0xe0, 0x00, 0x00, 0x00, 0x00, 0x00, 0x00, 0x0f, 0xff, 0xff, 0xff, 0xff
};

const unsigned char imageYaraba[] PROGMEM = {
  0xff, 0xff, 0xff, 0xff, 0xff, 0xff, 0xff, 0xff, 0xff, 0xff, 0xff, 0xff, 0xff, 0xff, 0xff, 0xff, 
0xff, 0xff, 0xff, 0xff, 0xff, 0xff, 0xff, 0xff, 0xff, 0xff, 0xff, 0xff, 0xff, 0xff, 0xff, 0xff, 
0xff, 0xff, 0xff, 0xff, 0xff, 0xff, 0xff, 0xff, 0xff, 0xff, 0xff, 0xff, 0xff, 0xff, 0xff, 0xff, 
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0xff, 0xff, 0xff, 0xff, 0xc0, 0x00, 0x00, 0x00, 0x00, 0x00, 0x00, 0x07, 0xff, 0xff, 0xff, 0xff
};

const unsigned char imageLeima[] PROGMEM = {
  0xff, 0xff, 0xff, 0xff, 0xff, 0xff, 0xff, 0xff, 0xff, 0xff, 0xff, 0xff, 0xff, 0xff, 0xff, 0xff, 
0xff, 0xff, 0xff, 0xff, 0xff, 0xff, 0xff, 0xff, 0xff, 0xff, 0xff, 0xff, 0xff, 0xff, 0xff, 0xff, 
0xff, 0xff, 0xff, 0xff, 0xff, 0xff, 0xff, 0xff, 0xff, 0xff, 0xff, 0xff, 0xff, 0xff, 0xff, 0xff, 
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0xff, 0xff, 0xff, 0xff, 0xff, 0xff, 0xff, 0xff, 0xff, 0xff, 0xff, 0xff, 0xff, 0xff, 0xff, 0xff
};

const unsigned char imagePriyo[] PROGMEM = {
  0xff, 0xff, 0xff, 0xff, 0xff, 0xff, 0xff, 0xff, 0xff, 0xff, 0xff, 0xff, 0xff, 0xff, 0xff, 0xff, 
0xff, 0xff, 0xff, 0xff, 0xff, 0xff, 0xff, 0xff, 0xff, 0xff, 0xff, 0xff, 0xff, 0xff, 0xff, 0xff, 
0xff, 0xff, 0xff, 0xff, 0xff, 0xff, 0xff, 0xff, 0xff, 0xff, 0xff, 0xff, 0xff, 0xff, 0xff, 0xff, 
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0xff, 0xff, 0xff, 0xff, 0xff, 0xff, 0xff, 0xff, 0xff, 0xff, 0xff, 0xf8, 0x00, 0x00, 0xff, 0xf3 
};


void setup() {
    Bridge.begin();
    pinMode(buzzerPin, OUTPUT);
    display.setI2CAddress(0x78);
    display.begin();
    display.setFont(u8g2_font_ncenB14_tr); 
}

void loop() {
    int potValue = analogRead(potPin);
    
    // Divide 1024 by 128 to get exactly 8 zones (0 through 7)
    int currentPart = potValue / 128;
    
    // Safety check just in case the math ever hits exactly 8
    if (currentPart > 7) { 
        currentPart = 7; 
    }

    // If the zone changed, update screen and beep
    if (currentPart != previousPart) {
        
        digitalWrite(buzzerPin, HIGH);
        delay(50);
        digitalWrite(buzzerPin, LOW);

        display.clearBuffer();  
        
        // Zone 0: Text "Pratik"
        if (currentPart == 0) {
            display.setCursor(30, 40); // Centered text
            display.print("Pratik");
        } 
        // Zone 1: Image Pratik
        else if (currentPart == 1) {
            display.drawBitmap(0, 0, 16, 64, imagePratik); 
        } 
        // Zone 2: Text "Yaraba"
        else if (currentPart == 2) {
            display.setCursor(30, 40);
            display.print("Yaraba");
        } 
        // Zone 3: Image Yaraba
        else if (currentPart == 3) {
            display.drawBitmap(0, 0, 16, 64, imageYaraba);
        } 
        // Zone 4: Text "Leima"
        else if (currentPart == 4) {
            display.setCursor(35, 40);
            display.print("Leima");
        } 
        // Zone 5: Image Leima
        else if (currentPart == 5) {
            display.drawBitmap(0, 0, 16, 64, imageLeima);
        } 
        // Zone 6: Text "Priyo"
        else if (currentPart == 6) {
            display.setCursor(35, 40);
            display.print("Priyo");
        } 
        // Zone 7: Image Priyo
        else if (currentPart == 7) {
            display.drawBitmap(0, 0, 16, 64, imagePriyo);
        }

        // Push everything to the physical screen
        display.sendBuffer(); 

        // Update memory
        previousPart = currentPart;
    }

    delay(15);
}
